## linux-2.4.18_1200_96C/net/Config.in
```kconfig
#
# Network configuration
#
mainmenu_option next_comment
comment 'Networking options'
tristate 'Packet socket' CONFIG_PACKET
if [ "$CONFIG_PACKET" != "n" ]; then
   bool '  Packet socket: mmapped IO' CONFIG_PACKET_MMAP
fi

tristate 'Netlink device emulation' CONFIG_NETLINK_DEV

bool 'Network packet filtering (replaces ipchains)' CONFIG_NETFILTER
if [ "$CONFIG_NETFILTER" = "y" ]; then
   bool '  Network packet filtering debugging' CONFIG_NETFILTER_DEBUG
fi
bool 'Socket Filtering'  CONFIG_FILTER
tristate 'Unix domain sockets' CONFIG_UNIX
bool 'TCP/IP networking' CONFIG_INET
if [ "$CONFIG_INET" = "y" ]; then
   source net/ipv4/Config.in
   if [ "$CONFIG_EXPERIMENTAL" = "y" ]; then
#   IPv6 as module will cause a CRASH if you try to unload it
      tristate '  The IPv6 protocol (EXPERIMENTAL)' CONFIG_IPV6
      if [ "$CONFIG_IPV6" != "n" ]; then
	 source net/ipv6/Config.in
      fi
   fi
   if [ "$CONFIG_EXPERIMENTAL" = "y" ]; then
      source net/khttpd/Config.in
   fi
fi
if [ "$CONFIG_EXPERIMENTAL" = "y" ]; then
   bool 'Asynchronous Transfer Mode (ATM) (EXPERIMENTAL)' CONFIG_ATM
   if [ "$CONFIG_ATM" = "y" ]; then
      if [ "$CONFIG_INET" = "y" ]; then
	 bool '  Classical IP over ATM' CONFIG_ATM_CLIP
	 if [ "$CONFIG_ATM_CLIP" = "y" ]; then
	    bool '    Do NOT send ICMP if no neighbour' CONFIG_ATM_CLIP_NO_ICMP
	 fi
      fi
      tristate '  LAN Emulation (LANE) support' CONFIG_ATM_LANE
      if [ "$CONFIG_INET" = "y" -a "$CONFIG_ATM_LANE" != "n" ]; then
	 tristate '    Multi-Protocol Over ATM (MPOA) support' CONFIG_ATM_MPOA
      fi
   fi

   dep_tristate '802.1Q VLAN Support (EXPERIMENTAL)' CONFIG_VLAN_8021Q $CONFIG_EXPERIMENTAL

fi

comment ' '
tristate 'The IPX protocol' CONFIG_IPX
if [ "$CONFIG_IPX" != "n" ]; then
   source net/ipx/Config.in
fi
tristate 'Appletalk protocol support' CONFIG_ATALK
tristate 'DECnet Support' CONFIG_DECNET
if [ "$CONFIG_DECNET" != "n" ]; then
   source net/decnet/Config.in
fi
dep_tristate '802.1d Ethernet Bridging' CONFIG_BRIDGE $CONFIG_INET
if [ "$CONFIG_EXPERIMENTAL" = "y" ]; then
   tristate 'CCITT X.25 Packet Layer (EXPERIMENTAL)' CONFIG_X25
   tristate 'LAPB Data Link Driver (EXPERIMENTAL)' CONFIG_LAPB
   bool '802.2 LLC (EXPERIMENTAL)' CONFIG_LLC
   bool 'Frame Diverter (EXPERIMENTAL)' CONFIG_NET_DIVERT
#   if [ "$CONFIG_LLC" = "y" ]; then
#      bool '  Netbeui (EXPERIMENTAL)' CONFIG_NETBEUI
#   fi
   if [ "$CONFIG_INET" = "y" ]; then
      tristate 'Acorn Econet/AUN protocols (EXPERIMENTAL)' CONFIG_ECONET
   fi
   if [ "$CONFIG_ECONET" != "n" ]; then
      bool '  AUN over UDP' CONFIG_ECONET_AUNUDP
      bool '  Native Econet' CONFIG_ECONET_NATIVE
   fi
   tristate 'WAN router' CONFIG_WAN_ROUTER
   bool 'Fast switching (read help!)' CONFIG_NET_FASTROUTE
   bool 'Forwarding between high speed interfaces' CONFIG_NET_HW_FLOWCONTROL
fi

mainmenu_option next_comment
comment 'QoS and/or fair queueing'
bool 'QoS and/or fair queueing' CONFIG_NET_SCHED
if [ "$CONFIG_NET_SCHED" = "y" ]; then
   source net/sched/Config.in
fi
#bool 'Network code profiler' CONFIG_NET_PROFILE
endmenu

mainmenu_option next_comment
comment 'IP Security Protocol (FreeS/WAN IPSEC)'
tristate 'IP Security Protocol (FreeS/WAN IPSEC)' CONFIG_IPSEC
if [ "$CONFIG_IPSEC" != "n" ]; then
  source net/ipsec/Config.in
fi
endmenu

bool 'RealTek IPSEC Enhancement' CONFIG_RTL_IPSEC
if [ "$CONFIG_RTL_IPSEC" = "y" ]; then
	bool '  Enable RealTek IPSEC Crypto Engine' CONFIG_RTL_IPSEC_HW
	bool '  Enable IPSec Logging for klogd' CONFIG_RTL_IPSEC_USER_LOG
	bool '  Enable RealTek IPSEC Protocol SPEEDUP' CONFIG_RTL_IPSEC_SPEEDUP
fi

comment 'RealTek FAST NAT'


bool 'Realtek IPTables Fast Path' CONFIG_RTK_IPTABLES_FAST_PATH
if [ "$CONFIG_RTL8196C" = "y" -o "$CONFIG_RTL8198" = "y" ]; then
bool 'Domain name query Support' CONFIG_DOMAIN_NAME_QUERY_SUPPORT
fi
bool 'RealTek Ethernet Driver Speedup support' CONFIG_DRIVER_SPEEDUP
if [ "$CONFIG_DRIVER_SPEEDUP" = "y" ]; then
   define_bool DRIVER_SPEEDUP y
   define_bool DELAY_RX y
fi

bool 'RealTek VLAN support' CONFIG_RTK_VLAN_SUPPORT

if [ "$CONFIG_RTK_VLAN_SUPPORT" = "y" ]; then
	dep_bool '   Selective Routing Type' CONFIG_RTK_VLAN_ROUTETYPE $CONFIG_RTK_VLAN_SUPPORT
	dep_bool '      Enable LAN-WAN L2 forwarding (un-tagged traffic) ' CONFIG_RTK_STB_PORT_SUPPORT $CONFIG_RTK_VLAN_ROUTETYPE
fi

bool 'RealTek IPv6 Pass Through support' CONFIG_RTK_IPV6_PASSTHRU_SUPPORT
bool 'RealTek VLC Speedup Support' CONFIG_RTK_VLC_SPEEDUP_SUPPORT
bool 'RealTek IPV6 MLD Support' CONFIG_RTL865X_SUPPORT_IPV6_MLD

endmenu
```

## linux-2.4.18_1200_96C/net/ipsec/Config.in
```kconfig
#
# IPSEC configuration
# Copyright (C) 1998, 1999, 2000,2001  Richard Guy Briggs.
# 
# This program is free software; you can redistribute it and/or modify it
# under the terms of the GNU General Public License as published by the
# Free Software Foundation; either version 2 of the License, or (at your
# option) any later version.  See <http://www.fsf.org/copyleft/gpl.txt>.
# 
# This program is distributed in the hope that it will be useful, but
# WITHOUT ANY WARRANTY; without even the implied warranty of MERCHANTABILITY
# or FITNESS FOR A PARTICULAR PURPOSE.  See the GNU General Public License
# for more details.
#
# RCSID $Id: Config.in,v 1.1.1.1 2004/07/28 06:27:38 ysc Exp $

comment 'IPSec options (FreeS/WAN)'

bool '   IPSEC: IP-in-IP encapsulation (tunnel mode)' CONFIG_IPSEC_IPIP

bool '   IPSEC: Authentication Header' CONFIG_IPSEC_AH
if [ "$CONFIG_IPSEC_AH" = "y" -o "$CONFIG_IPSEC_ESP" = "y" ]; then
  bool '      HMAC-MD5 authentication algorithm' CONFIG_IPSEC_AUTH_HMAC_MD5
  bool '      HMAC-SHA1 authentication algorithm' CONFIG_IPSEC_AUTH_HMAC_SHA1
fi

bool '   IPSEC: Encapsulating Security Payload' CONFIG_IPSEC_ESP
if [ "$CONFIG_IPSEC_ESP" = "y" ]; then
  bool '      3DES encryption algorithm' CONFIG_IPSEC_ENC_3DES
fi

bool '   IPSEC Modular Extensions' CONFIG_IPSEC_ALG
if [ "$CONFIG_IPSEC_ALG" != "n" ]; then
	source net/ipsec/alg/Config.in
fi

bool '   IPSEC: IP Compression' CONFIG_IPSEC_IPCOMP

bool '   IPSEC Debugging Option' CONFIG_IPSEC_DEBUG

bool '   IPSEC NAT-Traversal' CONFIG_IPSEC_NAT_TRAVERSAL

#
#
# $Log: Config.in,v $
# Revision 1.1.1.1  2004/07/28 06:27:38  ysc
#
# Initial version
#
# Revision 1.3  2002/09/05 03:53:52  ken
# Added NAT-T Patch
#
# Revision 1.2  2002/09/05 03:27:08  ken
# Applied freeswan-alg-0.8.0-BASE-klips.diff
#
# Revision 1.1.1.1  2002/09/05 03:13:17  ken
# 1.98b
#
# Revision 1.25  2002/02/21 19:55:12  mcr
# 	removed all traces of IPSEC_CONFIG_REGRESS because it
# 	screwed up 2.2's "make menuconfig" scripts.
#
# Revision 1.24  2002/01/28 20:24:31  mcr
# 	commented out IPSEC_REGRESS option from user visible config.
#
#
```

## linux-2.4.18_1200_96C/net/ipsec/alg/Config.in
```kconfig
#Placeholder
source net/ipsec/alg/Config.alg_md5.in
source net/ipsec/alg/Config.alg_sha1.in
source net/ipsec/alg/Config.alg_sha2.in
source net/ipsec/alg/Config.alg_3des.in
source net/ipsec/alg/Config.alg_aes.in
source net/ipsec/alg/Config.alg_blowfish.in
source net/ipsec/alg/Config.alg_twofish.in
source net/ipsec/alg/Config.alg_serpent.in
source net/ipsec/alg/Config.alg_cast.in
source net/ipsec/alg/Config.alg_null.in
source net/ipsec/alg/Config.alg_cryptoapi.in
source net/ipsec/alg/Config.alg_1des.in
```
